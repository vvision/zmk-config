//

#include <behaviors.dtsi>
#include <dt-bindings/zmk/keys.h>
#include <dt-bindings/zmk/bt.h>
#include <dt-bindings/zmk/outputs.h>
#include <dt-bindings/zmk/ext_power.h>

#include "layout.h"

#include "helpers.dtsi"
#include "shift_functions.dtsi"
#include "diacritics.dtsi"
#include "behaviors.dtsi"
#include "combos.dtsi"

/* MACROS */
#define WIN_TEAMS_MUTE LC(LS(M)) // Windows - Teams - Toggle Mute (Should be tested) // Ctrl + Shift + M
#define WIN_SCR LG(LS(S)) // Windows - Screenshot // Win + Shift + S
#define WIN_LDESK RC(LG(LEFT)) // Windows - Switch to left virtual desktop // Ctrl + Win + Left
#define WIN_RDESK RC(LG(RIGHT)) // Windows - Switch to right virtual desktop // Ctrl + Win + Right
#define W_DESK_EXPD LG(RIGHT) // Windows - Expand virtual desktop // Win + Tab

U_MACRO(sqt_space, wait-ms = <0>; bindings = <&kp SQT &kp SPACE>;)
U_MACRO(grave_space, wait-ms = <0>; bindings = <&kp GRAVE &kp SPACE>;)
U_MACRO(dqt_space, wait-ms = <0>; bindings = <&kp DQT &kp SPACE>;)
U_MACRO(tilde_space, wait-ms = <0>; bindings = <&kp TILDE &kp SPACE>;)

HOLD_TAP(hm_fr_u_circumflex, 175, &kp, &fr_u_circumflex)
HOLD_TAP(hm_dqt_space, 175, &kp, &dqt_space)

DOUBLE_TAP(dt_next_prev, 200, &kp C_NEXT, &kp C_PREV)

&sl {
    release-after-ms = <1500>;
};

/ {
  conditional_layers {
    compatible = "zmk,conditional-layers";
    adjust_layer {
      if-layers = <U_NAV U_SYM>;
      then-layer = <U_ADJUST>;
    };
  };

  keymap {
    compatible = "zmk,keymap";
#define MIRYOKU_X(LAYER, STRING) \
    LAYER { \
      label = STRING; \
      bindings = < U_MACRO_VA_ARGS(MIRYOKU_LAYERMAPPING_##LAYER, MIRYOKU_LAYER_##LAYER) >; \
    };
MIRYOKU_LAYER_LIST
#undef MIRYOKU_X
  };
};
